## configs/x6816d_defconfig
```kconfig
CONFIG_UMS512=y
CONFIG_SIMPLE_FB=y
CONFIG_INFINIX_X6816D=y
CONFIG_LINUX_KRNL_HEADER_IMG=y
CONFIG_TEXT_BASE=0x80080000
CONFIG_PAYLOAD_ENTRY=0x90000000
CONFIG_RAMDISK_ENTRY=0xa0000000
```
